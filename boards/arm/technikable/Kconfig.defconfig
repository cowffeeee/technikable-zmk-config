## boards/arm/technikable/Kconfig.defconfig
```kconfig
# Copyright (c) 2020 Pete Johanson
# SPDX-License-Identifier: MIT

if BOARD_TECHNIKABLE

config BOARD
	default "technikable"

config ZMK_KEYBOARD_NAME
	default "Technikable"

if USB

config USB_NRFX
	default y

config USB_DEVICE_STACK
	default y

endif # USB

config BT_CTLR
	default BT

config ZMK_BLE
	default y

config ZMK_USB
	default y
	
config BT_CTLR_TX_PWR_PLUS_8=y

endif # BOARD_TECHNIKABLE
```
